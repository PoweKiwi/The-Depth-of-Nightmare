//Chris (Kiwi)
//Feburary 19th, 2019
//Printing Text
/*
TODO
Main:
blacksmith shop
Different map to be loaded
bigger map + Scroll the map
-use/drop/cancel item
The Depth of Nitemare

Graphics: 
-scrolls

WISHLIST
INN and SHOP graphics.

Easy Monster:
beetle
a fly(dodges your attack)

Hard Monster:
Skeleton

Boss Monster:
Magician 


*/


#define SCROLLSTART 5
#define HARDENEMYLISTSTART 12
#define MAPMAXIMUM 13
#include <Arduboy2.h>
//static_cast<Print &>(arduboy).write(name, sizeof(name));
Arduboy2 arduboy;

//unsigned char TileID;
//unsigned char playerx = 1;
//unsigned char playery = 2;

//unsigned char tileset[512];
bool battleon = 0;
unsigned char TileID,playerx,playery,stage,playercond,hard,
tile,key,MapID,hardenemy,NewWeaponID,NewArmorID,scrolly,offsety,
x,y,a,b,c,d,i,e,f,ID,cooldown,oldpx,oldpy,game,counter,
Level,Attack,Defense,WeaponID,ArmorID,WeaponMin,WeaponMax,ArmorClass;
unsigned int Gold,GoldAward,Experience,NextExp;
int HP,MaxHP,damage,TotalMin,TotalMax,tempattack,tempdefense;
unsigned int WeaponPrice,ArmorPrice,OldWeaponPrice,OldArmorPrice;
unsigned char WeaponName[12],ArmorName[12],WeaponNameSale[12],ArmorNameSale[12],EnemyName[8],
Inventory[6];
//unsigned char MonsterImage[32];

const unsigned char PlayerStartPosX[] PROGMEM = {1,5,4,1,4,5,2,4,3,7,2,1,3};
const unsigned char PlayerStartPosY[] PROGMEM ={2,17,8,2,9,8,1,0,8,19,16,10,16};

const unsigned int NextExpList[] PROGMEM = {
2,8,10,25,40,80,120,160,210,260,//10
330,380,440,500,555,640,700,777,860,960,//20
1040,1200,1500,1800,2140,2300,2500,3200,3500,3900,//30
4300,4900,5600,6300,7000,7300,7600,8000,8500,9100,//40
9600,10500,12000,14000,16000,19000,22000,26000,30000,35000,//50
41000,46000,52000,56000,60000,61000,62000,63000,63500,64000,//60

};

const unsigned char FloorGuardianList[] PROGMEM = {
12,13,14,15,16,17,18,19,20,20,19,18,21
};

const unsigned char ItemNameList[] PROGMEM = {
'-','-','-',' ',' ',' ',
'P','o','t','i','o','n',//Restore 100HP
'M','e','a','t',' ',' ',//Restore 50HP
'B','r','e','a','d',' ',//Restore 30HP
'H','e','r','b',' ',' ',//Restore 15HP
'F','i','r','e','S','c',//Harm enemy -halfHP
'A','c','i','d','S','c',//destroy defense and harm enemy -5HP
'I','c','e',' ','S','c',//Chance to freeze Enemy -10HP
'L','i','f','e','S','c',//Full recovery/revive if in bag
'P','o','w',' ','S','c',//increase your attack/def
'T','o','x','i','S','c',//Poison enemy
};

const unsigned char EnemyNameList[] PROGMEM = {
'D','a','r','k','B','l','o','b',
'G','r','a','y',' ','B','a','t',
'W','h','i','t','e','R','a','t',
'D','o','o','m','8','L','e','g',

'A','n','g','r','y','F','l','y',
'T','o','r','t','o','i','s','e',
'W','e','e','d','L','i','o','n',
'C','h','i','c','k','e','n','?',

'W','h','i','t','e','L','i','z',
'I','p','o','d','B','a','l','l',
'M','u','p','p','e','t',' ',' ',
'N','o','t','G','o','m','b','a',

'S','n','a','k','e','y',' ',' ',
'G','r','a','y','W','o','l','f',
'S','k','e','l','e','t','o','n',

'B','i','g','S','l','i','m','e',
'M','a','n','E','a','t','e','r',
'M','a','g','i','c','i','a','n',

'T','e','r','r','a','O','a','k',
'B','a','d','D','r','a','k','o',
'D','a','r','k','N','i','t','e',

'N','i','t','e','M','a','r','e',
  
};
//' ',' ',' ',' ',' ',' ',' ',' ',
//enemystat I need to learn struct don't I?
int EnHP,ExpAward;//GoldAward
unsigned char EnID,EnMP,EnAtk,EnDef,EnCon;
//EnHP,MP,Atk,def,expA,goldA
const unsigned char EnemyStatTable[] PROGMEM= {
10,2,7,1,4,5,//slime
15,2,9,1,6,7,//bat
20,3,6,2,12,10,//rat
30,4,8,0,10,10,//spider

40,3,18,0,15,15,//Angry Fly
50,3,18,15,30,25,//tortoise
45,5,15,10,20,40,//diadalion
50,3,20,12,32,32,//Chicken?

70,9,30,10,40,50,//White Lizard
80,8,30,20,30,40,//I pod ball
120,10,30,30,66,100,//Muffet
150,12,35,34,88,70,//Not Gooba


48,3,14,7,35,50,//snake
60,2,15,7,45,40,//wolf
120,3,20,16,60,70,//Skeleton

160,4,25,10,100,100,//Big Slime
150,4,30,9,150,125,//Man Eater
120,9,15,30,150,150,//Magician

200,5,45,35,200,200,//Terror Oak
250,9,70,25,225,225,//Badly Drawn Dragon
255,9,80,50,250,250,//Knightmare
250,15,100,65,255,255,
};

const unsigned char EasyEnemyGraphic[] PROGMEM = {
0x00, 0x00, 0x00, 0x00, 0x80, 0x40, 0xa0, 0xd0, 0xd0, 0xf0, 0xe0, 0xc0, 0x00, 0x00,
0x00, 0x00, 0x00, 0x1c, 0x22, 0x5d, 0x7e, 0xef, 0xcd, 0xed, 0xcf, 0xed, 0xcd, 0xef,
0x7f, 0x7e, 0x3c, 0x00, 0xe0, 0x18, 0xa6, 0xd, 0xf0, 0x1f, 0x26, 0x32, 0x32, 0x26, 
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0x4a, 0x4a, 0x4c, 0x35, 0x1d, 0x1d, 0x1d, 0x35, 0x4c, 0x4a, 0x4a, 0x31, 0x00, };
const unsigned char HardEnemyGraphic[] PROGMEM = {
0x00, 0x00, 0x00, 0x00, 0x00, 0x00, 0x00, 0x80, 0x80, 0xe0, 0xf8, 0xfc, 0x7e, 0x7e, 0xf3, 
0x4d, 0x2d, 0x9, 0x31, 0x9, 0x2e, 0x4e, 0x3e, 0xf8, 0xe0, 0xb0, 0x58, 0x38, 0xfc, 0x7c,
0x3f, 0x7, 0x13, 0x11, 0xb0, 0xf0, 0xc9, 0x47, 0xa4, 0x63, 0x65, 0xd3, 0xaf, 0xbd, 0xaf,
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0x00, 0x00, 0x00, 0x10, 0x38, 0x1a, 0xdd, 0xf5, 0xff, 0xca, 0xb2, 0x45,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 0x00, 
};


const unsigned char background[] PROGMEM = {
0x30, 0x92, 0x34, 0xb2, 0x86, 0x92, 0xa6, 0x96, 0x30, 0x92, 0x34, 0xb2,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 0xf, 
};
const unsigned char player[] PROGMEM = {
0x00, 0xe0, 0x00, 0x00, 0x10, 0x68, 0xd4, 0xf4, 0xd4, 0x68, 0x90, 0x00,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 0x1, 
};
const unsigned char keyGraphic[] PROGMEM = {
0x00, 0x00, 0x3c, 0x42, 0x42, 0x42, 0x42, 0x3c, 0x10, 0x10, 0x70, 0x10, 0x10, 0x10, 0x70, 0x00, 0x00, 0x3c, 0x42, 0xbd, 0xa5, 0xa5, 0xbd, 0x42, 0x2c, 0x68, 0x88, 0x68, 0x28, 0x68, 0x88, 0x78, 
};
const unsigned char PoisonGraphic[] PROGMEM = {
0x41, 0x22, 0xc, 0x12, 0x11, 0x31, 0x7b, 0x2f, 0x2f, 0x7b, 0x31, 0x11, 0x12, 0xc, 0x22, 0x41, 0x00, 0xc, 0x12, 0x2d, 0x2a, 0x4a, 0x84, 0x50, 0x50, 0x84, 0x4a, 0x2a, 0x2d, 0x12, 0xc, 0x00, 
};

const unsigned char Titleplaque[] PROGMEM = {
0x80, 0x00, 0x2, 0x3e, 0x2, 0x00, 0x3e, 0x8, 0x30, 0x00, 0x18, 0x34,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 0x3e, 
};

const unsigned char Kiwiplaque[] PROGMEM = {
0x7f, 0x43, 0x75, 0x43, 0x7f, 0x41, 0x75, 0xcb, 0xff, 0xc1, 0xdd, 0x63,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 0x74, 
  
};

const unsigned char Chalice[] PROGMEM = {
  0xf0, 0x28, 0x44, 0x44, 0x82, 0x82, 0x82, 0x82, 0x82, 0x1, 0x5, 0x5,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 0x00, 

};

const unsigned char GameoverGraphic[] PROGMEM = {
0xf8, 0xfe, 0x7, 0x3, 0x23, 0xe7, 0xe6, 0x00, 0x80, 0xf0, 0xfc, 0xc7,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 0x7,   
  
};

const unsigned char WeaponNameList[] PROGMEM = {
'F','i','s','t',' ','a',' ','C','u','f','f',' ',
'W','o','o','d','e','n',' ','S','t','i','c','k',  
'O','a','k',' ','C','l','u','b',' ',' ',' ',' ',
'B','u','l','l',' ','W','h','i','p',' ',' ',' ',

'C','o','p','p','e','r',' ','S','w','o','r','d',
'C','h','a','i','n',' ','W','h','i','p',' ',' ',
'I','r','o','n',' ','M','a','c','e',' ',' ',' ',
'B','r','o','a','d',' ','S','w','o','r','d',' ',

'S','t','e','e','l',' ','F','r','a','i','l',' ',
'G','l','a','d','i','u','s',' ',' ',' ',' ',' ',
'T','r','i','d','e','n','t',' ',' ',' ',' ',' ',
'M','o','r','n','i','n','g',' ','S','t','a','r',

'S','t','e','e','l',' ','A','x','e',' ',' ',' ',
'S','i','l','v','e','r',' ','B','l','a','d','e',
'F','l','a','m','e',' ','W','h','i','p',' ',' ',
'E','x','c','a','l','i','b','u','r',' ',' ',' ',
'O','u','t',' ','o','f',' ','S','t','o','c','k',



};

const unsigned char WeaponMinDamage[] PROGMEM ={
0,1,2,4,6,8,7,9,
12,11,14,16,
20,24,21,28,99};

const unsigned char WeaponMaxDamage[] PROGMEM ={
5,4,6,9,12,13,15,18,
24,25,35,40,
44,46,50,60,99};

const unsigned int WeaponPriceList[] PROGMEM ={
0,10,40,80,
125,200,340,500,
650,1000,1500,2500,
4000,5500,8000,12000,65535};


const unsigned char ArmorNameList[] PROGMEM = {
'B','i','r','t','h','d','a','y','S','u','i','t',
'C','o','t','t','o','n',' ','S','h','i','r','t',
'W','o','o','l',' ','S','u','i','t',' ',' ',' ',
'L','e','a','t','h','e','r','A','r','m','o','r',

'W','o','o','d','e','n',' ','M','a','i','l',' ',  
'C','h','a','i','n',' ','M','a','i','l',' ',' ',  
'C','o','p','p','e','r',' ','A','r','m','o','r',
'I','r','o','n',' ','M','a','i','l',' ',' ',' ',

'B','r','o','n','z','e',' ','A','r','m','o','r',
'S','t','e','e','l',' ','P','l','a','t','e',' ',
'F','u','l','l',' ','P','l','a','t','e',' ',' ',
'S','i','l','v','e','r',' ','A','r','m','o','r',

'G','o','l','d',' ','P','l','a','t','e',' ',' ',
'D','r','a','g','o','n',' ','A','r','m','o','r',
'E','m','e','r','a','l','d','A','r','m','o','r',
'D','i','a','m','o','n','d','A','r','m','o','r',
'O','u','t',' ','o','f',' ','S','t','o','c','k',







};

const unsigned char ArmorClassValue[] PROGMEM ={
0,1,2,3,4,6,8,10,
12,14,16,18,
20,23,25,30,99};

const unsigned int ArmorPriceList[] PROGMEM = {
0,20,55,100,130,200,360,450,
750,1025,2000,3050,
5000,7500,10000,12500,65535};

unsigned char sampleMAP[160];


const unsigned char Map01a[] PROGMEM = {
 0x00, 0x00, 0x00, 0x00,
 0x04, 0xb0, 0x62, 0xa0,
 0x02, 0x00, 0x10, 0x20,
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 0x00, 0x00, 0x00, 0x00,
//};//80
//const unsigned char Map02[] PROGMEM = {
0x08,0x00,0x00,0x00,
0x02,0x51,0x60,0xf0,
0x04,0x00,0xb0,0xe0,
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0x00,0x02,0x2f,0x22,

/*
0-wall   1-lock 2-floor  3-spike
4-easyE  5-hardE  6-chest  7-Shop
8-INN  9-Mystery a-Meat  b-Scroll
c-key  D-Bag  E-FloorGuardian  f-Down

*/





0x00,0x00,0x00,0x00,
0x00,0x22,0x20,0x00,
0x00,0x2f,0x20,0x00,
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0x00,0x00,0x00,0x00,



};


/*
Empty Map
0x00,0x00,0x00,0x00,
0x00,0x00,0x00,0x00,
0x00,0x00,0x00,0x00,
0x00,0x00,0x00,0x00,
0x00,0x00,0x00,0x00,
0x00,0x00,0x00,0x00,
0x00,0x00,0x00,0x00,
0x00,0x00,0x00,0x00,
0x00,0x00,0x00,0x00,
0x00,0x00,0x00,0x00,
0x00,0x00,0x00,0x00,
0x00,0x00,0x00,0x00,
0x00,0x00,0x00,0x00,
0x00,0x00,0x00,0x00,
0x00,0x00,0x00,0x00,
0x00,0x00,0x00,0x00,
0x00,0x00,0x00,0x00,
0x00,0x00,0x00,0x00,
0x00,0x00,0x00,0x00,
0x00,0x00,0x00,0x00,
*/

void LoadMap(unsigned char MapID){
 a=0;x=0;
 for(i=0;i!=80;i++){
  a=pgm_read_byte(Map01a+(MapID*80)+i);
  y=a&0x0f;
  a=a/16;
  sampleMAP[x] = a;
  x++;
// a=pgm_read_byte(Map01a+i);
// a=a&0x0f;

  sampleMAP[x] = y;
  x++;
 }
}

void AddItem(void){
a=0;
for(ID=0;ID!=6;ID++){
if(Inventory[ID]==0){
Inventory[ID]=c;
goto ItemAddedx;
}//addingitem
}//for
a=1;
ItemAddedx:
return 0;
}


void TwoChoices(void){
f=0;y=48;//arduboy.setCursor(0,y);
arduboy.drawChar(0,y,62,WHITE,BLACK,1);
delay(192);
while (f==0){delay(1);if(arduboy.pressed(A_BUTTON)){f=1;}
if(arduboy.pressed(B_BUTTON)){f=4;}
//if(cooldown!=0){cooldown--;}
//if(cooldown==0){
if(arduboy.pressed(UP_BUTTON)){arduboy.drawChar(0,y,32,WHITE,BLACK,1);
y=48;arduboy.drawChar(0,y,62,WHITE,BLACK,1);}
if(arduboy.pressed(DOWN_BUTTON)){arduboy.drawChar(0,y,32,WHITE,BLACK,1);
y=55;arduboy.drawChar(0,y,62,WHITE,BLACK,1);}

arduboy.display();  
  
}  
}  

void YesOrNo(void){
arduboy.fillRect(0,48,32,16,BLACK);
arduboy.setCursor(6,49);
arduboy.print(F("Yes\n No"));

TwoChoices();
//arduboy.display();
}//end subroutine

void UseOrDrop(void){
arduboy.setCursor(0,0);

for(i=0;i!=6;i++){
c=pgm_read_byte(ItemNameList+i+Inventory[ID]*6);
arduboy.write(c);
}//i
  
arduboy.fillRect(0,48,32,128,BLACK);
arduboy.setCursor(6,48);
arduboy.print(F("Use\n Drop"));
TwoChoices();  
if(y==55){Inventory[ID]=0;}  
}

void InventoryOrStatus(void){
//arduboy.fillRect(0,48,32,16,BLACK);
arduboy.setCursor(6,48);
arduboy.print(F("Check Bag\n Status"));
TwoChoices();  
switch(y){
case 48:InventoryScreen();break;
case 55:StatusScreen();break;
}
}

void PickCommand(void){
arduboy.fillRect(0,48,128,32,BLACK);
arduboy.setCursor(8,48);
arduboy.print(F("FIGHT  DEFEND\n ITEM   RUN"));

f=0;y=48;x=0;//arduboy.setCursor(0,y);
arduboy.drawChar(x,y,62,WHITE,BLACK,1);
//cooldown=10;
delay(192);
while (f==0){delay(1);
counter++;
if(arduboy.pressed(A_BUTTON)){f=1;}
//if(cooldown!=0){cooldown--;}
//if(cooldown==0){
if(arduboy.pressed(UP_BUTTON)){arduboy.drawChar(x,y,32,WHITE,BLACK,1);
y=48;arduboy.drawChar(x,y,62,WHITE,BLACK,1);}
if(arduboy.pressed(LEFT_BUTTON)){arduboy.drawChar(x,y,32,WHITE,BLACK,1);
x=0;arduboy.drawChar(x,y,62,WHITE,BLACK,1);}
if(arduboy.pressed(DOWN_BUTTON)){arduboy.drawChar(x,y,32,WHITE,BLACK,1);
y=55;arduboy.drawChar(x,y,62,WHITE,BLACK,1);}
if(arduboy.pressed(RIGHT_BUTTON)){arduboy.drawChar(x,y,32,WHITE,BLACK,1);
x=42;arduboy.drawChar(x,y,62,WHITE,BLACK,1);}
//cooldown
arduboy.display();
}//while
}  


void WaitForButton(void){
arduboy.display();
delay(190);
f=0;
while (f==0){
delay(1);counter++;
if(arduboy.pressed(A_BUTTON)){f=1;}
}}


void InventoryScreen() {
arduboy.fillRect(0,48,128,32,BLACK);//erasetextbox
arduboy.setCursor(0,48);arduboy.print(F(">"));
for(ID=0;ID!=6;ID++){
for(i=0;i!=6;i++){
c=pgm_read_byte(ItemNameList+i+Inventory[ID]*6);
arduboy.write(c);
}//i
arduboy.print(F(" "));
if(ID==2){arduboy.print(F("\n "));}
}//ID
//sample
f=0;y=48;x=0;cooldown=60;
while(f==0){delay(3);counter++;
if(cooldown!=0){cooldown--;}
if(cooldown==0){
if(arduboy.pressed(A_BUTTON)){f=2;}
if(arduboy.pressed(B_BUTTON)){f=1;}
if(arduboy.pressed(UP_BUTTON)){arduboy.drawChar(x,y,32,WHITE,BLACK,1);
y=48;arduboy.drawChar(x,y,62,WHITE,BLACK,1);cooldown=60;}
if(arduboy.pressed(LEFT_BUTTON) && x!=0){arduboy.drawChar(x,y,32,WHITE,BLACK,1);
x-=42;arduboy.drawChar(x,y,62,WHITE,BLACK,1);cooldown=60;}
if(arduboy.pressed(DOWN_BUTTON)){arduboy.drawChar(x,y,32,WHITE,BLACK,1);
y=55;arduboy.drawChar(x,y,62,WHITE,BLACK,1);cooldown=60;}
if(arduboy.pressed(RIGHT_BUTTON)&& x<=80){arduboy.drawChar(x,y,32,WHITE,BLACK,1);
x+=42;arduboy.drawChar(x,y,62,WHITE,BLACK,1);cooldown=60;}
arduboy.display();
}//endcooldown
}//endwhile
if(f==2){
if(y==48){a=0;}
if(y!=48){a=3;}
x=x/42;
ID=x+a;
if(battleon==0){UseOrDrop();if(f==4){goto cancelselection;}}
arduboy.fillRect(0,48,128,32,BLACK);//erasetextbox
arduboy.setCursor(0,48);
switch(Inventory[ID]){
case 1:
arduboy.print(F("Recovered 100 HP.\nHP:"));playercond=0;
HP+=100;if(HP>MaxHP){HP=MaxHP;}
arduboy.print(HP);arduboy.display();WaitForButton();f=2;
break;
case 2:
arduboy.print(F("Recovered 50 HP.\nHP:"));playercond=0;
HP+=50;if(HP>MaxHP){HP=MaxHP;}
arduboy.print(HP);arduboy.display();WaitForButton();f=2;
break;
case 3:
arduboy.print(F("Recovered 30 HP.\nHP:"));playercond=0;
HP+=30;if(HP>MaxHP){HP=MaxHP;}
arduboy.print(HP);arduboy.display();WaitForButton();f=2;
break;
case 4:
arduboy.print(F("Recovered 15 HP.\nHP:"));playercond=0;
HP+=15;if(HP>MaxHP){HP=MaxHP;}
arduboy.print(HP);arduboy.display();WaitForButton();f=2;
break;
case SCROLLSTART:
if(battleon==0){goto notinbattle;}
damage=EnHP/2;if(damage<=20){damage=20;}
f=3;
arduboy.print(F("You burn your foe!\n"));
break;
case SCROLLSTART+1:
if(battleon==0){goto notinbattle;}
damage=5;EnDef=0;f=3;
arduboy.print(F("Foe's armor melted\n away!"));
break;
case SCROLLSTART+2:
if(battleon==0){goto notinbattle;}
damage=10;EnDef=0;f=3;EnCon=1;
arduboy.print(F("You freeze your foe!\n"));
break;
case SCROLLSTART+3:
if(battleon==0){goto notinbattle;}
HP=MaxHP;
f=2;playercond=0;
arduboy.print(F("Your HP is maxed out.\n"));
WaitForButton();
break;
case SCROLLSTART+4:
if(battleon==0){goto notinbattle;}
tempattack+=40;tempdefense+=40;
arduboy.print(F("You greatly increase\nyour atk and def!"));
WaitForButton();f=2;
break;
case SCROLLSTART+5:
if(battleon==0){goto notinbattle;}
damage=10;EnDef=0;f=3;EnCon=2;
arduboy.print(F("You poisoned your\nenemy!"));
break;

}//switch
Inventory[ID]=0;
}//f==2

cancelselection:
return 0;
notinbattle:
arduboy.print(F("Only used during\nbattle."));WaitForButton();
return 0;
}


void Levelup(void){
arduboy.clear();
arduboy.setCursor(0,0);arduboy.print(F("Leveled up!"));
arduboy.setCursor(0,8);arduboy.print(F("MaxHP:"));arduboy.print(MaxHP);
arduboy.print(F("-->"));MaxHP+=random(4,12);arduboy.print(MaxHP);HP=MaxHP;
arduboy.setCursor(0,16);arduboy.print(F("Atk:"));arduboy.print(Attack);
arduboy.print(F("-->"));Attack+=random(1,4);arduboy.print(Attack);
arduboy.setCursor(0,24);arduboy.print(F("Def:"));arduboy.print(Defense);
arduboy.print(F("-->"));Defense+=random(1,2);arduboy.print(Defense);



Level++;


Experience=0;
WaitForButton();
}


void EnemySkill(void){
EnMP--;f=0;

switch(EnID){
case 0:
case 15:
arduboy.print(F(" spits slime\nfor "));//12letters, 8letters
damage=EnAtk+8-Defense-ArmorClass;
break;//slime
case 1:arduboy.print(F(" super sonic\nscreech "));//12letters, 8letters
10-Defense-ArmorClass;break;//bat
case 2:
case 4:
case 11:
arduboy.print(F(" powered up."));//12letters, 8letters
EnAtk+=EnAtk+2+EnAtk/8;f=1;
break;//rat
case 3:
case 10:
arduboy.print(F(" spits web &\nglued you in place."));//12letters, 8letters
playercond=1;f=1;
break;//spider
case 18://terror oak
case 16://maneater
case 8:
case 6:arduboy.print(F(" ray a light\ncast upon itself.HP++"));
EnHP=EnHP+=20;
f=1;
break;//flower lizard
case 14:
case 20:
case 5:arduboy.print(F(" fortified\nitself."));
EnDef=EnDef+2+EnDef/8;
f=1;
break;//tortoise
case 7:arduboy.print(F(" peckstormed\n you for "));//12letters, 8letters
damage=(EnAtk*3)-Defense-ArmorClass;
break;//Chicken?
case 9:

case 13:
arduboy.print(F(" stares down\nyou.Atk and Def down."));//12letters, 8letters
tempdefense-=10;tempattack-=10;
f=1;
break;//eyeball
case 12:
arduboy.print(F(" venomous bit\nyou for "));
TotalMin=EnAtk/2;TotalMax=EnAtk*1.25;
damage=random(TotalMin,TotalMax)-Defense-ArmorClass-tempdefense;
playercond=2;
break;//snake poison
case 17:
case 19:
case 21:
arduboy.print(F(" cast fire at\nyou for "));
damage=random(20,50);
break;
}//switch
}

void Battle(void){
battleon=1;EnCon=0;
tempattack=0;
tempdefense=0;
arduboy.clear();
if(hardenemy==0){EnID=stage+counter%3;
if(EnID>=12){EnID=random(0,11);}}//example


if(hardenemy==1){c=random(0,stage);
if(c>=9){c=random(0,8);}
EnID=HARDENEMYLISTSTART+c;}
if(hardenemy==2){EnID=pgm_read_byte(FloorGuardianList+MapID);}
//for(i=0;i!=32;i++){
//MonsterImage[i]=pgm_read_byte(EasyEnemyGraphic+i+64);}
for(i=0;i!=8;i++){
EnemyName[i]=pgm_read_byte(EnID*8+EnemyNameList+i);}

  EnHP=pgm_read_byte(EnemyStatTable+EnID*6);
  if(EnID==21){EnHP=EnHP*4;}
  EnMP=pgm_read_byte(EnemyStatTable+EnID*6+1);
  EnAtk=pgm_read_byte(EnemyStatTable+EnID*6+2);
  EnDef=pgm_read_byte(EnemyStatTable+EnID*6+3);
  ExpAward=pgm_read_byte(EnemyStatTable+EnID*6+4);
  GoldAward=pgm_read_byte(EnemyStatTable+EnID*6+5);
  arduboy.setCursor(0,0);
  arduboy.print(F("HP:"));arduboy.print(HP);arduboy.print(F("/"));arduboy.print(MaxHP);
  arduboy.setCursor(0,8);arduboy.print(F("EH:"));arduboy.print(EnHP);
  /*
  arduboy.print(F("M:"));arduboy.print(EnMP);
  arduboy.print(F("A:"));arduboy.print(EnAtk);
  arduboy.print(F("D:"));arduboy.print(EnDef);
  arduboy.print(F("E:"));arduboy.print(ExpAward);
  */
  arduboy.fillRect(48,16,32,32,WHITE);
  arduboy.drawRect(49,17,30,30,BLACK);
  if(hardenemy==0){arduboy.drawBitmap(56,24,EasyEnemyGraphic+EnID*32,16,16,BLACK);}
  if(hardenemy>=1){arduboy.drawBitmap(52,20,HardEnemyGraphic+(EnID-HARDENEMYLISTSTART)*72,24,24,BLACK);}
//  background+sampleMAP[tile]*32
  arduboy.setCursor(0,48);for(i=0;i!=8;i++){arduboy.write(EnemyName[i]);}
  arduboy.print(F("\napproaches."));
WaitForButton(); 

Commandhere:
 PickCommand();
arduboy.fillRect(0,48,128,32,BLACK);//erasetextbox
if(x==0 && y==48){goto fightmonster;}//fight
if(x==42 && y==48){
arduboy.setCursor(0,48);arduboy.print(F("You defend yourself"));
WaitForButton();
goto monsterattack;
}//defend
if(x==0 && y==55){InventoryScreen();
if(f==2){goto monsterattack;}
if(f==3){goto CastScroll;}
goto Commandhere;}//item
if(x==42 && y==55){
arduboy.setCursor(0,48);
i=counter%4;
if(i==1 && hardenemy!=2){arduboy.fillRect(49,17,30,30,WHITE);
arduboy.print(F("Escaped!"));
WaitForButton();goto EndBattle;}
arduboy.print(F("Blocked!"));
WaitForButton();
goto monsterattack;}//run
goto Commandhere;
fightmonster:



arduboy.setCursor(0,48);arduboy.print(F("You attack "));for(i=0;i!=8;i++){arduboy.write(EnemyName[i]);}
if(EnID==4){
c=random(0,3);
if(c==1){
arduboy.print(F("\nbut missed. "));  
WaitForButton();
goto monsterattack; 
}

}

arduboy.print(F("\nfor "));
TotalMin=(WeaponMin+Attack+tempattack)/2;
//TotalMin=e-e;
TotalMax=WeaponMax+Attack+tempattack;
TotalMax=TotalMax*1.25;
damage=random(TotalMin,TotalMax)-EnDef;
if(damage<=0){damage=1;}


//if(counter>=224){arduboy.print(F("Crit!"));damage=(WeaponMax+Attack-EnDef)*1.50;if(damage<3){damage=3;}}
//if(counter>=128 && counter<224){damage=WeaponMax+Attack-EnDef;if(damage<2){damage=2;}}
//if(counter<128 && counter>=32){damage=WeaponMin+Attack-EnDef;if(damage<1){damage=1;}}
//if(counter<32){damage=(WeaponMin+Attack-EnDef)/2;if(damage<0){damage=0;}}
CastScroll:
arduboy.print(damage);arduboy.print(F(" damage."));
EnHP=EnHP-damage;

if(EnCon==2){
WaitForButton();
arduboy.fillRect(0,48,128,32,BLACK);//erasetextbox
damage=EnHP/8;
arduboy.setCursor(0,48);arduboy.print(F("The enemy got "));
arduboy.print(damage);arduboy.print(F("\npoison damage."));
WaitForButton();
}


if(EnHP<0){EnHP=0;}
arduboy.fillRect(0,8,128,8,BLACK);//erase EnHP
arduboy.setCursor(0,8);arduboy.print(F("EnHP:"));arduboy.print(EnHP);
WaitForButton();
if (EnHP==0){goto DefeatedFoe;}

monsterattack:
if(EnCon==1){arduboy.fillRect(0,48,128,32,BLACK);//erasetextbox
arduboy.setCursor(0,48);arduboy.print(F("The enemy is frozen."));
c=counter%2;
if(c==1){arduboy.print(F("\nNow thawed and ready."));EnCon=0;}
WaitForButton();goto Commandhere;}

if(x==42 && y==48 && EnID==0){
arduboy.fillRect(0,48,128,32,BLACK);//erasetextbox
arduboy.setCursor(0,48);arduboy.print(F("The monster ponders\n and wonders away."));
WaitForButton();goto EndBattle;
}

arduboy.fillRect(0,48,128,32,BLACK);//erasetextbox
arduboy.setCursor(0,48);for(i=0;i!=8;i++){arduboy.write(EnemyName[i]);}
c=counter%3;
if(c==0 && EnMP!=0){EnemySkill();
if(f==0){goto usedskill;}
if(f==1){goto nodamageskill;}
}//use skill



arduboy.print(F(" attacked you\nfor "));
TotalMin=EnAtk/2;TotalMax=EnAtk*1.25;
damage=random(TotalMin,TotalMax)-Defense-ArmorClass-tempdefense;


usedskill:
if(x==42 && y==48){damage=damage/4;}
if(damage<0){damage=1;}
arduboy.print(damage);
HP=HP-damage;
if(HP<0){HP=0;}
arduboy.print(F(" in damage."));
arduboy.fillRect(0,0,128,8,BLACK);//erase HP
  arduboy.setCursor(0,0);
  arduboy.print(F("HP:"));arduboy.print(HP);arduboy.print(F("/"));arduboy.print(MaxHP);
nodamageskill:
  WaitForButton();
  
if(playercond==1){
arduboy.fillRect(0,48,128,32,BLACK);//erasetextbox
arduboy.setCursor(0,48);
c=random(0,2);  
if(c==0){  
arduboy.print(F("You're wrapped in\nweb."));}
if(c==1){  
arduboy.print(F("You unwrapped off\nthe webbing."));playercond=0;}  
WaitForButton();
goto monsterattack;
}
if(playercond==2){
arduboy.fillRect(0,48,128,32,BLACK);//erasetextbox
arduboy.setCursor(0,48);
damage=MaxHP/16;
HP=HP-damage;
if(HP<0){HP=0;}
arduboy.print(F("You suffered\n"));
arduboy.print(damage);
arduboy.print(F(" in poison damage."));
arduboy.fillRect(0,0,128,8,BLACK);//erase HP
  arduboy.setCursor(0,0);
  arduboy.print(F("HP:"));arduboy.print(HP);arduboy.print(F("/"));arduboy.print(MaxHP);
  WaitForButton();
}  
if(HP<=0){
for(ID=0;ID!=6;ID++){
if(Inventory[ID]==8){Inventory[ID]=0;HP=MaxHP;
arduboy.fillRect(0,48,128,32,BLACK);//erasetextbox
arduboy.setCursor(0,48);playercond=0;
arduboy.print(F("Revived! Life scroll\nused!"));
arduboy.fillRect(0,0,128,8,BLACK);//erase HP
  arduboy.setCursor(0,0);
  arduboy.print(F("HP:"));arduboy.print(HP);arduboy.print(F("/"));arduboy.print(MaxHP);
WaitForButton();

goto Commandhere;
}  
  
}}
if(HP<=0){game=3;goto EndBattle;}  
goto Commandhere;

DefeatedFoe:
arduboy.fillRect(48,16,32,32,WHITE);
arduboy.fillRect(0,48,128,32,BLACK);//erasetextbox
arduboy.setCursor(0,48);arduboy.print(F("Enemy defeated!Got\n"));
arduboy.print(F("Exp:"));arduboy.print(ExpAward);arduboy.print(F(" Gold:"));arduboy.print(GoldAward);
Experience+=ExpAward;Gold+=GoldAward;
WaitForButton();
if(Experience>=pgm_read_word(NextExpList+Level)){Levelup();}
EndBattle:
battleon=0;
return 0;
}




void StatusScreen(void){
arduboy.clear();
arduboy.setCursor(0,0);
arduboy.print(F("Status"));
arduboy.setCursor(0,7);
arduboy.print(F("Level:"));arduboy.print(Level);
arduboy.print(F(" Depth:"));arduboy.print(stage);

arduboy.setCursor(0,14);
arduboy.print(F("HP:"));arduboy.print(HP);arduboy.print(F("/"));arduboy.print(MaxHP);
arduboy.setCursor(0,21);
arduboy.print(F("Attack:"));arduboy.print(Attack);
arduboy.print(F(" WP:"));
arduboy.print(WeaponMin);
arduboy.print(F(" - "));
arduboy.print(WeaponMax);
    
arduboy.setCursor(0,28);
arduboy.print(F("Defense:"));arduboy.print(Defense);
arduboy.print(F(" AC:"));
arduboy.print(ArmorClass);

arduboy.setCursor(0,35);
arduboy.print(F("Weapon:"));    
for(i=0;i!=12;i++){arduboy.write(WeaponName[i]);}

//arduboy.print("Wooden Stick");
arduboy.setCursor(0,42);
arduboy.print(F("Armor:"));
for(i=0;i!=12;i++){arduboy.write(ArmorName[i]);}
//arduboy.print("Cotton Shirt");
arduboy.setCursor(0,49);
arduboy.print(F("Exp:"));arduboy.print(Experience);arduboy.print(F("/"));arduboy.print(pgm_read_word(NextExpList+Level));
arduboy.setCursor(0,56);
arduboy.print(F("Gold:"));arduboy.print(Gold);

WaitForButton();
}



void ChestCard(void){
arduboy.setCursor(0,0);
arduboy.print(F("Chest!\n"));
GoldAward=random(50,225);
//switch(c){
//case 0:GoldAward=25;break;
//case 1:GoldAward=50;break;
//case 2:GoldAward=100;break;
//default:arduboy.print(F("It's empty"));
//}//switch
//if(GoldAward!=0){}
arduboy.print(GoldAward);arduboy.print(F("gold!"));Gold+=GoldAward;


WaitForButton();
}

void FoodCard(void){
arduboy.setCursor(0,0);
arduboy.print(F("Meat!\nDo you eat it?"));  
YesOrNo();
arduboy.fillRect(0,48,128,16,BLACK);
arduboy.setCursor(0,48);
switch(y){
case 48:arduboy.print(F("Yum!! +50hp"));HP+=50;playercond=0;if(HP>MaxHP){HP=MaxHP;}break;
case 55:c=2;AddItem();arduboy.print(F("You put it in your\n bag."));
if(a==1){arduboy.print(F("But it's full!"));WaitForButton();arduboy.fillRect(0,48,128,16,BLACK);
arduboy.setCursor(0,48);arduboy.print(F("Bunch of mice took\nthe meat away."));}break;  

}

WaitForButton();
}


void TrapCard(void){
arduboy.setCursor(0,0);
arduboy.print(F("Trap!!!\n"));
c=counter%8;
switch(c){
case 1:arduboy.print(F("Spike Trap -5HP."));HP-=5;break;
case 2:arduboy.print(F("Gas Trap -2HP."));HP-=2;break;
case 4:arduboy.print(F("Pit Trap -10HP."));HP-=10;break;
case 5:arduboy.print(F("Healing Trap +5HP."));HP+=5;playercond=0;break;
case 6:arduboy.print(F("Poison gas!!!"));playercond=2;break;
case 7:arduboy.print(F("Raining gold coins.\nOUCH! +10 gold, -10HP"));HP-=10;Gold+=10;break;
default:arduboy.print(F("Didn't fire."));}
if(HP>MaxHP){HP=MaxHP;}
if(HP<0){HP=0;}
arduboy.print(F("\nHP:"));arduboy.print(HP);

WaitForButton();
}

void BagCard(void){
arduboy.setCursor(0,0);
arduboy.print(F("You've found a bag!\nDo you want to open\n it?"));
YesOrNo();
arduboy.fillRect(0,48,128,16,BLACK);
arduboy.setCursor(0,48);
switch(y){
case 48:c=counter%5;c=c+1;
switch(c){
case 1:arduboy.print(F("Potion."));break;
case 2:arduboy.print(F("Meat."));break;
case 3:arduboy.print(F("Bread."));break;
case 4:arduboy.print(F("Herb."));break;
case 5:arduboy.print(F("25 gold piece"));Gold+=25;break;
default:arduboy.print(F("???"));break;
}
AddItem();
if(a==1){arduboy.fillRect(0,48,128,16,BLACK);
arduboy.setCursor(0,48);arduboy.print(F("Your bag is full and\n the bag implodes."));WaitForButton();}break;
case 55:arduboy.print(F("You leave the bag"));WaitForButton();b=1;break;
}  
WaitForButton();  
}

void INNCard(void){
arduboy.setCursor(0,0);
arduboy.print(F("Welcome to my hotel!\nYou can stay and rest\nfor 50 gold, stay?"));
YesOrNo();
arduboy.fillRect(0,48,128,16,BLACK);
arduboy.setCursor(0,48);
if(y==48 && Gold<=50){arduboy.print(F("You do not have\n enough gold."));WaitForButton();}
if(y==48 && Gold>=50){arduboy.print(F("Zzz.. "));WaitForButton();arduboy.print(F("All rested up."));playercond=0;Gold-=50;HP=MaxHP;WaitForButton();b=0;}
//if(f==4){b=1;}

}

void ScrollCard(void){
arduboy.setCursor(0,0);
arduboy.print(F("You've found a scroll!\nDo you want to take\n it?"));
YesOrNo();
arduboy.fillRect(0,48,128,16,BLACK);
arduboy.setCursor(0,48);
switch(y){
case 48:c=counter%6;c=c+SCROLLSTART;AddItem();
if(a==1){arduboy.print(F("Your bag is full and\n the scroll crumbles."));WaitForButton();}break;
case 55:arduboy.print(F("You leave the scroll"));WaitForButton();b=1;break;
}
  
}

void ShopCard(void){
arduboy.setCursor(0,0);
arduboy.print(F("Welcome to my\nblacksmith.What do\nyou wish to buy?\nGOLD:"));
arduboy.print(Gold);

OldWeaponPrice=pgm_read_word(WeaponPriceList+WeaponID);
arduboy.print(F("\n+W:"));arduboy.print(OldWeaponPrice);

OldArmorPrice=pgm_read_word(ArmorPriceList+ArmorID);
arduboy.print(F("\n+A:"));arduboy.print(OldArmorPrice);


arduboy.fillRect(0,48,128,16,BLACK);
arduboy.setCursor(8,48);

NewWeaponID=WeaponID+1;
//if (NewWeaponID>=15){NewWeaponID=15;}
for(i=0;i!=12;i++){
WeaponNameSale[i]=pgm_read_byte(NewWeaponID*12+WeaponNameList+i);}
WeaponPrice=pgm_read_word(WeaponPriceList+NewWeaponID);
for(i=0;i!=12;i++){arduboy.write(WeaponNameSale[i]);}
arduboy.print(F(" "));arduboy.print(WeaponPrice);arduboy.print(F("\n "));
NewArmorID=ArmorID+1;
//if (NewArmorID>=15){NewArmorID=15;}
for(i=0;i!=12;i++){
ArmorNameSale[i]=pgm_read_byte(NewArmorID*12+ArmorNameList+i);}
ArmorPrice=pgm_read_word(ArmorPriceList+NewArmorID);
for(i=0;i!=12;i++){arduboy.write(ArmorNameSale[i]);}
arduboy.print(F(" "));arduboy.print(ArmorPrice);

TwoChoices();

arduboy.fillRect(0,48,128,16,BLACK);
arduboy.setCursor(0,48);
if(f==4){goto leaveblacksmith;}
if(y==48){
if(WeaponPrice-OldWeaponPrice<=Gold){Gold=Gold+OldWeaponPrice-WeaponPrice;
WeaponID=NewWeaponID;
for(i=0;i!=12;i++){
WeaponName[i]=pgm_read_byte(WeaponID*12+WeaponNameList+i);}
WeaponMin=pgm_read_byte(WeaponMinDamage+WeaponID);
WeaponMax=pgm_read_byte(WeaponMaxDamage+WeaponID);  
arduboy.print(F("Traded weapon."));}
else{arduboy.print(F("Not enough gold."));}  
  
}//y48
if(y==55){
if(ArmorPrice-OldArmorPrice<=Gold){Gold=Gold+OldArmorPrice-ArmorPrice;
ArmorID=NewArmorID;
for(i=0;i!=12;i++){
ArmorName[i]=pgm_read_byte(ArmorID*12+ArmorNameList+i);}
ArmorClass=pgm_read_byte(ArmorClassValue+ArmorID);
  
arduboy.print(F("Traded armor."));}
else{arduboy.print(F("Not enough gold."));}
}
  
WaitForButton();    
leaveblacksmith:
return 0;
}

void NewFloor(void){
key=0;
stage++;
MapID++;
if(MapID>=MAPMAXIMUM){game=4;goto mapskip;}
if(MapID==12 && scrolly>=70){MapID=random(0,11);goto mapskip;}

if(MapID!=12 &&stage>11){MapID=11;goto mapskip;}
if(MapID!=12 &&hard==1){MapID=random(0,11);}
mapskip:

playerx=pgm_read_byte(PlayerStartPosX+MapID);
playery=pgm_read_byte(PlayerStartPosY+MapID);
LoadMap(MapID);
}

void checkBGtile(void){
//x=playerx;
//y=playery;
TileID=sampleMAP[playerx+playery*8];
if(TileID==9){TileID=random(3,13);
if(TileID==9){TileID=4;}
if(TileID==7){TileID=12;}
if(TileID==8){TileID=4;}
}
b=0;
switch(TileID){
case 1:if(key!=0){key--;break;}
case 0:
b=1;
break;
case 3:TrapCard();break;
case 4:hardenemy=0;Battle();break;
case 5:hardenemy=1;Battle();break;
case 6:ChestCard();break;
case 7:ShopCard();b=1;break;
case 8:b=1;INNCard();break;
case 10:FoodCard();break;
case 11:ScrollCard();break;
case 12:key++;break;
case 13:BagCard();break;
case 14:hardenemy=2;Battle();break;
case 15:NewFloor();goto dontremoveobject;
//default:
b=0;

}
sampleMAP[oldpx+oldpy*8]=2;
dontremoveobject:
return 0;
}

void StartNewGame(void){
  
  Level=1;playercond=0;stage=0;
 MaxHP=30;
 HP=MaxHP;
 Attack=4;
Defense=0;
WeaponID=1-hard;
for(i=0;i!=12;i++){
WeaponName[i]=pgm_read_byte(WeaponID*12+WeaponNameList+i);}
    WeaponMin=pgm_read_byte(WeaponMinDamage+WeaponID);
    WeaponMax=pgm_read_byte(WeaponMaxDamage+WeaponID);

ArmorID=1-hard;
for(i=0;i!=12;i++){
ArmorName[i]=pgm_read_byte(ArmorID*12+ArmorNameList+i);}
    ArmorClass=pgm_read_byte(ArmorClassValue+ArmorID);

Gold=0;
Experience=0;  
  game=0;
  Inventory[0]=2;  Inventory[1]=0;  Inventory[2]=0;  
  Inventory[3]=0;  Inventory[4]=0;  Inventory[5]=0;
 scrolly=192;
 /*
for(i=0;i!=160;i++){
sampleMAP[i] = pgm_read_byte(Map01+i);}
 */
 

LoadMap(0);
MapID=0;
playerx=pgm_read_byte(PlayerStartPosX+MapID);
playery=pgm_read_byte(PlayerStartPosY+MapID);
  
}

/////////////////////////////////////////////////////SETUP
void setup() {
    arduboy.boot();//without begin - 11092, with 10342
    arduboy.clear();
    arduboy.setFrameRate(20);
    arduboy.initRandomSeed();

  
  

i=0;
}
////////////////////////////////////////////////////*********

void loop() {

//  arduboy.allPixelsOn(1);
while(game==0){
  if(!arduboy.nextFrame()){return;}
  arduboy.clear();
  arduboy.invert(1);
  arduboy.drawBitmap(48,16,Kiwiplaque,32,32,INVERT);
  arduboy.display();
//for(i=0;i!=250;i++){
//  delay(200);
//if(!arduboy.nextFrame()){return;}
//} 
  //arduboy.clear();
  i++;
  if(i==120){game=1;arduboy.invert(0);arduboy.clear();}
}

while(game==1){
if(!arduboy.nextFrame()){return;}
//arduboy.clear();
//InventoryScreen();
//Battle();
arduboy.drawBitmap(32,0,Titleplaque,64,32,WHITE);
arduboy.setCursor(0,48);
arduboy.print(F(">Easy\n Hard"));
//if(arduboy.pressed(A_BUTTON)){
//  StartNewGame();
//  game=2;}
TwoChoices(); 
if(y=48){hard=0;StartNewGame();game=2;}
if(y=55){hard=1;StartNewGame();game=2;}  
  //if(arduboy.pressed(B_BUTTON)){game=4;}
//arduboy.display();
}//game==0



while(game==2){
if(!arduboy.nextFrame()){return;}
arduboy.clear();
counter++;

//if(arduboy.pressed(A_BUTTON)){tile--;}
//if(arduboy.pressed(B_BUTTON)){tile++;}
arduboy.setCursor(0,0);
tile=0;
for(int bgy=0;bgy<240;bgy+=12){
for(int bgx=0;bgx<128;bgx+=16){
    
  arduboy.drawBitmap(bgx,bgy-192+scrolly,background+sampleMAP[tile]*32,16,16,WHITE);
  tile++;//arduboy.display();
}}
//arduboy.fillRect(0,0,6,7,BLACK);
//arduboy.setCursor(0,0);arduboy.print(playery*12-184+scrolly);
if(playery*12-192+scrolly>=42){scrolly-=4;}
if(playery*12-192+scrolly<=10){scrolly+=4;}

arduboy.drawBitmap(playerx*16,(playery*12)-192+scrolly,player,16,16,WHITE);
arduboy.drawBitmap(playerx*16,(playery*12)-192+scrolly,player+32,16,16,BLACK);
if(playercond==2){
arduboy.drawBitmap(0,0,PoisonGraphic,16,8,WHITE);
arduboy.drawBitmap(0,0,PoisonGraphic+16,16,8,BLACK);


}
if(key!=0){
for(i=0;i!=key;i++){
arduboy.drawBitmap(112,0+i*2,keyGraphic,16,8,WHITE);
arduboy.drawBitmap(112,0+i*2,keyGraphic+16,16,8,BLACK);
}}

if(cooldown!=0){cooldown--;}
if(cooldown==0){
//if(arduboy.pressed(A_BUTTON)){InventoryScreen();cooldown=15;goto exfa;}  
if(arduboy.pressed(B_BUTTON)){InventoryOrStatus();cooldown=15;}  

if(arduboy.pressed(RIGHT_BUTTON)&& playerx<7){oldpx=playerx;oldpy=playery;
  playerx++;cooldown=4;
checkBGtile();
if(b==1){playerx--;}}
//for(y=0;y!=6;y++){
//if(sampleMAP[oldpx+y*8]!=0){
//sampleMAP[oldpx+y*8]=1;}}

if(arduboy.pressed(LEFT_BUTTON)&& playerx!=0){oldpx=playerx;oldpy=playery;
  playerx--;cooldown=4;
checkBGtile();
if(b==1){playerx++;}}

if(arduboy.pressed(UP_BUTTON) && playery!=0){oldpx=playerx;oldpy=playery;
playery--;
checkBGtile();cooldown=4;
if(b==1){playery++;}  
}
if(arduboy.pressed(DOWN_BUTTON)&& playery<19){oldpx=playerx;oldpy=playery;
playery++;
checkBGtile();cooldown=4;
if(b==1){playery--;}
}
}

if(HP<=0){game=3;}
arduboy.display();
}//game==3

if(game==3){

//arduboy.setCursor(28,28);
//arduboy.print(F("GAME OVER :("));
//arduboy.display();
delay(240);
while(game==3){
delay(10);
arduboy.clear();
arduboy.drawBitmap(48,0,GameoverGraphic,32,56,INVERT); 
if(arduboy.pressed(A_BUTTON)){
  game=0;}
arduboy.display();
}//game==0
}//game2
//ifgame2

if(game==4){
//  delay(240);
//  a=0;
  
  for(y=64;y!=7;y--){
    arduboy.clear();  
  delay(200);
  arduboy.drawBitmap(48,y,Chalice,32,48,INVERT); 
  arduboy.display(); 
  }
/*
  y=56;
while(a==0){
  if(!arduboy.nextFrame()){return;}   
  
if(y==8){a=1;}

y--;

}
*/
while(game==4){
arduboy.clear();  
arduboy.setCursor(40,56);
arduboy.print("You win!");

arduboy.drawBitmap(48,8,Chalice,32,48,INVERT);  
if(arduboy.pressed(A_BUTTON)){game=0;}  
  
  
arduboy.display(); 
}}









}//loop